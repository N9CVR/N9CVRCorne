## config/boards/shields/n9cvr_oled_display/Kconfig.defconfig
```kconfig
# SPDX-License-Identifier: MIT

if SHIELD_N9CVR_OLED_DISPLAY

config ZMK_DISPLAY
    default y

config DISPLAY
    default y

config SSD1306
    default y

config I2C
    default y

config LVGL
    default y

endif
```

## config/boards/shields/n9cvr_oled_display/Kconfig.shield
```kconfig
# SPDX-License-Identifier: MIT

config SHIELD_N9CVR_OLED_DISPLAY
    def_bool $(shields_list_contains,n9cvr_oled_display)
```

## config/boards/shields/n9cvr_oled_ui/Kconfig.shield
```kconfig
# SPDX-License-Identifier: MIT

config SHIELD_N9CVR_OLED_UI_CW_LEFT
    def_bool $(shields_list_contains,n9cvr_oled_ui_cw_left)

config SHIELD_N9CVR_OLED_UI_CW_RIGHT
    def_bool $(shields_list_contains,n9cvr_oled_ui_cw_right)

config SHIELD_N9CVR_OLED_UI_CCW_LEFT
    def_bool $(shields_list_contains,n9cvr_oled_ui_ccw_left)

config SHIELD_N9CVR_OLED_UI_CCW_RIGHT
    def_bool $(shields_list_contains,n9cvr_oled_ui_ccw_right)

config SHIELD_N9CVR_OLED_UI_LANDSCAPE_LEFT
    def_bool $(shields_list_contains,n9cvr_oled_ui_landscape_left)

config SHIELD_N9CVR_OLED_UI_LANDSCAPE_RIGHT
    def_bool $(shields_list_contains,n9cvr_oled_ui_landscape_right)

config SHIELD_N9CVR_OLED_UI_ANY
    def_bool SHIELD_N9CVR_OLED_UI_CW_LEFT || SHIELD_N9CVR_OLED_UI_CW_RIGHT || SHIELD_N9CVR_OLED_UI_CCW_LEFT || SHIELD_N9CVR_OLED_UI_CCW_RIGHT || SHIELD_N9CVR_OLED_UI_LANDSCAPE_LEFT || SHIELD_N9CVR_OLED_UI_LANDSCAPE_RIGHT

config SHIELD_N9CVR_OLED_UI_LEFT
    def_bool SHIELD_N9CVR_OLED_UI_CW_LEFT || SHIELD_N9CVR_OLED_UI_CCW_LEFT || SHIELD_N9CVR_OLED_UI_LANDSCAPE_LEFT

config SHIELD_N9CVR_OLED_UI_RIGHT
    def_bool SHIELD_N9CVR_OLED_UI_CW_RIGHT || SHIELD_N9CVR_OLED_UI_CCW_RIGHT || SHIELD_N9CVR_OLED_UI_LANDSCAPE_RIGHT
```

## config/west.yml
```yaml
manifest:
  defaults:
    revision: n9cvr-v0.3
  remotes:
    - name: n9cvr
      url-base: https://github.com/N9CVR
  projects:
    - name: zmk
      remote: N9CVRzmk
      import: app/west.yml
  self:
    path: config
```
